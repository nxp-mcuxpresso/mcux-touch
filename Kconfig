## Kconfig
```kconfig
menu "Touch"
    config MCUX_COMPONENT_middleware.touch
        bool "touch library"
        help
            NXP Touch Library.

    config MCUX_COMPONENT_middleware.touch.sources_frdmke1xz
        bool "FRDM_KE1xZ sources"
        help
            NXP Touch Library - sources for frdmke15z, frdmke16z, frdmke17z boards.

    config MCUX_COMPONENT_middleware.touch.sources_frdmk32l2a4s
        bool "FRDM_K32L2A4S sources"
        help
            NXP Touch Library - sources for FRDMK-K32L2A4S board.

    config MCUX_COMPONENT_middleware.touch.sources_frdmmcxn
        bool "FRDM_MCXN sources"
        help
            NXP Touch Library - sources for frdmmcxn947, mcxn5xxevk, mcxn9xxevk boards.
endmenu
```
